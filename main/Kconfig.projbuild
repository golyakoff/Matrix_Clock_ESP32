## main/Kconfig.projbuild
```kconfig
menu "Matrix Clock"

    config MC_FLASH_MB
        int "Flash size of the board, MB"
        default 4
        help
            Gates the Animation Splash animations that only fit bigger boards
            (see animations.h) and names the build variant.

    config MC_BUILD_VARIANT
        string "Build variant"
        default "release_4mb"
        help
            Name of the release asset this build is published as
            (tetris-clock_<version>_<variant>_fw.bin), also the build key
            the clock looks for in the release manifest.

    config MC_UPDATE_MANIFEST_URL
        string "Update manifest URL"
        default "https://github.com/golyakoff/Matrix_Clock_ESP32/releases/latest/download/manifest.json"
        help
            Where the clock reads the release manifest of the update from the
            internet (updater.h): the latest GitHub release.

    config MC_UPDATE_BETA_MANIFEST_URL
        string "Beta update manifest URL"
        default "https://github.com/golyakoff/Matrix_Clock_ESP32/releases/download/beta/manifest.json"
        help
            Where a clock on the beta update channel also reads the manifest of
            the latest beta (updater.h): the "beta" pre-release, which CI updates
            on every vX.Y.Z-betaN tag.

    config MC_DISPLAY_DOUBLE_BUFFER
        bool "Double-buffered display"
        default n
        help
            Draw each frame into a second buffer and show it whole (PxMatrix
            double_buffer), instead of clearing and redrawing the buffer the
            refresh ISR is scanning, which can show half-drawn frames of the
            falling blocks. Costs one more frame buffer of RAM.

endmenu
```
